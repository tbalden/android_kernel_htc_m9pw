## arch/arm64/Kconfig.htc
```kconfig
comment "HTC Debugging Features"
menuconfig HTC_DEBUG
        bool "HTC Debugging Feature Switch"
        default y
        help
          Enable collection of debug features.
          This feature is enabled in defconfig.

comment "HTC features"
menuconfig HTC_FEATURES
        bool "HTC Implement Features"
        default n
        help
          Enable collection of HTC features.
          This feature is enabled in defconfig.

if HTC_FEATURES

config HTC_MODEM_EXCEPTION_INFO_EXPORT
        bool "HTC modem exception info export"
        depends on HTC_FEATURES && MTK_ECCCI_DRIVER
        default n
        help
          export modem exception info for tell htc

endif

comment "HTC Debug Flag"
menuconfig HTC_ORR
	bool "HTC Debug Flag Features"
        default y
	help
          Enable Debug Flag features.

config HTC_FEATURES_RIL_PCN0004_HTC_GARBAGE_FILTER
        tristate "HTC_FEATURES_RIL_PCN0004_HTC_GARBAGE_FILTER"
        default y
        depends on MTK_ECCCI_DRIVER && HTC_FEATURES
        ---help---
          Garbage Filter of TCP
```

## drivers/htc_debug/stability/Kconfig
```kconfig
#
# HTC_DEBUG stability Kconfig
#
config HTC_DEBUG_KP
        default y
        depends on HTC_DEBUG
        bool "HTC style kernel panic debug features"
        help
          Say Y here if you want the HTC style kernel panic debug features

config HTC_DEBUG_RTB
        default y
        depends on HTC_DEBUG && MSM_RTB
        bool "HTC style kernel panic debug features"
        help
          Say Y here if you want the HTC style kernel panic debug features

config HTC_DEBUG_WATCHDOG
        bool "HTC style watchdog debug features"
        depends on HTC_DEBUG && MTK_WD_KICKER
        help
          Say Y here if you want the HTC style watchdog debug features


config HTC_PROCESS_DEBUG
        bool "process/thread debug support"
        default y
        help
          This option enables kernel debug log to check if any
          assigned process receives signal or unexpected exit
```

## drivers/i2c/chips/Kconfig
```kconfig
#
# Miscellaneous I2C chip drivers configuration
#
# *** DEPRECATED! Do not add new entries! See Makefile ***
#

menu "Miscellaneous I2C Chip support"

config AMP_RT5506
        tristate "Richtek RT5506 AMP Driver"
	depends on I2C=y
        help
          Richtek RT5506 AMP Driver implemented by HTC.

config AMP_TFA9895
	tristate "NXP TFA9895 Speaker AMP Driver"
	depends on I2C=y
	help
		NXP TFA9895 Speaker AMP Driver implemented by HTC.

config AMP_TFA9895L
	tristate "NXP TFA9895L Speaker AMP Driver"
	depends on I2C=y
	help
		NXP TFA9895L Speaker AMP Driver implemented by HTC.

config SENSORS_NFC_PN544
	tristate "PN544 NFC sensor support"
	depends on I2C=y
	help
	  PN544 NFC Driver implemented.

config INPUT_CWSTM32
	tristate "CyWee CWSTM32 Sensor HUB"
	depends on I2C && INPUT
	select INPUT_POLLDEV
	help
		This driver provides support for CWSTM32 Sensor HUB

config CWSTM32_DEBUG
	tristate "CyWee CWSTM32 Sensor HUB DEBUG MECHANISM"
	depends on INPUT_CWSTM32
	help
		This driver depends on CWSTM32 Sensor HUB for enable DEBUG.

config SYNC_TOUCH_STATUS
    bool "Sync touch i2c switch status to sensor hub"
    default n
    help
        Sync touch i2c switch status to sensor hub

endmenu
```

## drivers/misc/config/Kconfig
```kconfig
config FORCE_FAST_CHARGE
	bool "Force AC charge mode at will"
	default y
	help
	  A simple sysfs interface to force adapters that
	  are detected as USB to charge as AC.

config FINGERPRINT_MOD
	bool "Fingerprint Mod"
	default y
	help
	  Fingerprint modification - a simple sysfs interface to 
	  enable kernelspace fingerprint tweaks, like sleep/recent apps.
```

## drivers/misc/fpr_CrucialTec/Kconfig
```kconfig
#
# TI's shared transport line discipline and the protocol
# drivers (BT, FM and GPS)
#

config FPR_CT
	bool "SPI driver for fingerprint"
       default n
	help
       SPI driver for finger print
```

## drivers/misc/htc/Kconfig
```kconfig
#
# HTC MISC Driver Kconfig
#
config HTC_REBOOT_REASON_INFORMATION
        default y
        bool "HTC style reboot reason information features"
        help
          Say Y here if you want the HTC style reboot reason information features

config HTC_DEBUG_BOOTLOADER_LOG
	default y
	bool "HTC Bootloader Log Support"
	help
	  Say Y here if you want the HTC Bootloader Log Support

config TI_TCA6418
	default n
	tristate "TCA6418 GPIO expander support"
	help
	  If you say yes here you get support for Texas Instruments
	  GPIO expander TCA6418.

config HTC_RECEIVER
	default n
	tristate "Receiver Control circuit support"
	help
	  Say Y if you are using specific GPIO for Receiver Control.
```

## drivers/misc/mediatek/flashlight/Kconfig
```kconfig
config MTK_FLASHLIGHT
  bool CONFIG_MTK_FLASHLIGHT
  default n
  help
    CONFIG_MTK_FLASHLIGHT

config HTC_FLASHLIGHT_COMMON
        tristate "Common flashlight API for camera"
        help
          Say Y here to enable the common API for front flashlight utilization

config FLASHLIGHT_TPS61310
        tristate "TI TPS61310 flashlight"
        help
          Say Y here to enable the TI TPS61310 flashlight

config FLASHLIGHT_SY7802
        tristate "SILERGY SY7802 flashlight"
        help
          Say Y here to enable the SILERGY SY7802 flashlight
```
